/dts-v1/;

/ {
    compatible = "test,round32-proxy-fixture";
    model = "ROUND32 child-scoped proxy schema fixture (proxy-supply not a phandle)";
    #address-cells = <1>;
    #size-cells = <1>;

    regulators {
        compatible = "qcom,pm8150-rpmh-regulators";
        qcom,pmic-id = "a";

        vreg_l5: ldo5 {
            regulator-name = "pm8150_l5";
            /* plain u32 cell instead of a phandle reference */
            proxy-supply = <880000>;
            qcom,proxy-consumer-enable;
            qcom,proxy-consumer-current = <100000>;
        };
    };
};
