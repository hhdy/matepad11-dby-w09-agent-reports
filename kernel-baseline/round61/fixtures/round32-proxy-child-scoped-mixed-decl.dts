/dts-v1/;

/ {
    compatible = "test,round32-proxy-fixture";
    model = "ROUND32 child-scoped proxy schema fixture (mixed declarations)";
    #address-cells = <1>;
    #size-cells = <1>;

    regulators {
        compatible = "qcom,pm8150-rpmh-regulators";
        qcom,pmic-id = "a";
        /* legacy group-level declaration on the provider node ... */
        proxy-supply = <&vreg_l5>;

        vreg_l5: ldo5 {
            regulator-name = "pm8150_l5";
            /* ... combined with a child-scoped declaration: the schema
             * cannot express this cross-node exclusivity, so this fixture
             * is accepted here by design and rejected at runtime by
             * regulator_proxy_consumer_register() with -EINVAL.  Covered
             * by the host mock test (group+child double declaration).
             */
            proxy-supply = <&vreg_l5>;
            qcom,proxy-consumer-enable;
            qcom,proxy-consumer-current = <100000>;
        };
    };
};
