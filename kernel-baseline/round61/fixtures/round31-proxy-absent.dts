/dts-v1/;

/ {
    compatible = "test,round31-proxy-fixture";
    model = "ROUND31 proxy consumer schema fixture";
    #address-cells = <1>;
    #size-cells = <1>;

    regulators {
        compatible = "qcom,pm8150-rpmh-regulators";
        qcom,pmic-id = "a";

        vreg_l5: ldo5 {
            regulator-name = "pm8150_l5";
            regulator-min-microvolt = <880000>;
            regulator-max-microvolt = <880000>;
        };
    };
};
